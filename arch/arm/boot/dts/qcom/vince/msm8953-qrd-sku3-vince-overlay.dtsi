#include "msm-audio-vince.dtsi"
#include "msm-pm8953-vince.dtsi"
#include "msm-pmi8950-vince.dtsi"
#include "msm8953-pinctrl-vince.dtsi"
#include "msm8953-audio-vince.dtsi"
#include "msm8953-camera-sensor-qrd-vince.dtsi"
#include "msm8953-mdss-panels-vince.dtsi"
#include "msm8953-mdss-pll-vince.dtsi"
#include "msm8953-pm-vince.dtsi"
#include "msm8953-qrd-sku3-vince.dtsi"
#include "msm8953-vince.dtsi"
#include "msm8953-qrd-vince.dtsi"
#include "msm8953-regulator-vince.dtsi"
