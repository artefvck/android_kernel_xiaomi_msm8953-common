#include "msm-audio-daisy.dtsi"
#include "msm-pm8953-daisy.dtsi"
#include "msm-pmi8950-daisy.dtsi"
#include "msm8953-pinctrl-daisy.dtsi"
#include "msm8953-audio-daisy.dtsi"
#include "msm8953-camera-sensor-qrd-daisy.dtsi"
#include "msm8953-mdss-panels-daisy.dtsi"
#include "msm8953-mdss-pll-daisy.dtsi"
#include "msm8953-pm-daisy.dtsi"
#include "msm8953-qrd-sku3-daisy.dtsi"
#include "msm8953-daisy.dtsi"
#include "msm8953-qrd-daisy.dtsi"
#include "msm8953-regulator-daisy.dtsi"
